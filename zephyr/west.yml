## zephyr/west.yml
```yaml
manifest:
  version: "0.13"
  remotes:
    - name: zephyrproject
      url-base: https://github.com/zephyrproject-rtos
  projects:
    - name: zephyr
      remote: zephyrproject
      revision: v3.7.2
      path: deps/zephyr
      import: true
  self:
    path: firmware
```
